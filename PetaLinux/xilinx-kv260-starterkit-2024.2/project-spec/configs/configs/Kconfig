## PetaLinux/xilinx-kv260-starterkit-2024.2/project-spec/configs/configs/Kconfig
```kconfig
mainmenu "PetaLinux System Configuration"
config SUBSYSTEM_TYPE_LINUX
        bool
        default y
        select SYSTEM_ZYNQMP

config SYSTEM_ZYNQMP
        bool "ZYNQMP Configuration"
        help
          ZYNQMP Configuration for petalinux project.
          All these config options will be in /home/kevin/dev/HITL_PX4_KV260-RPU_TB/PetaLinux/xilinx-kv260-starterkit-2024.2/project-spec/configs/config

config SUBSYSTEM_VARIANT_ZYNQMPEV
        bool
        default y
        help

config SUBSYSTEM_SDT_FLOW
        bool
        default y
        help

config SUBSYSTEM_DISTRO_PETALINUX
        bool
        default y
        help

source /home/kevin/dev/HITL_PX4_KV260-RPU_TB/PetaLinux/xilinx-kv260-starterkit-2024.2/project-spec/configs/configs/Kconfig.main
```

## PetaLinux/xilinx-kv260-starterkit-2024.2/project-spec/configs/rootfsconfigs/Kconfig.user
```kconfig
menu "user packages " 
config gpio-demo  
	 bool "gpio-demo"
	 help
	
config packagegroup-kria  
	 bool "packagegroup-kria"
	 help
	
config peekpoke  
	 bool "peekpoke"
	 help
	
endmenu
```
